## linux-4.12.10/drivers/mykcprofile/Kconfig
```kconfig
#
# device driver configuration
#

config  MYKCPROFILE
	tristate "timer module"
	default n
        help
	 timer module triggers every 500msec
```

## linux-4.12.10/drivers/mytaskinfo/Kconfig
```kconfig
#
# device driver configuration
#

config  MYTASKINFO
	tristate "timer module"
	default n
        help
	 timer module triggers every 500msec
```

## linux-4.12.10/drivers/mytime/Kconfig
```kconfig
#
# device driver configuration
#

config  MYTIME
	tristate "timer module"
	default n
        help
	 timer module triggers every 500msec
```
